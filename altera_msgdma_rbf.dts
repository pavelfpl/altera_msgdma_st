/*
 * Copyright (C) 2018 Pavel Fiala 
 *               2015 Intel (Altera) Corporation 
 *
 * This program is free software; you can redistribute it and/or modify it
 * under the terms of the GNU General Public License as published by the Free
 * Software Foundation; either version 2 of the License, or (at your option)
 * any later version.
 *
 * This program is distributed in the hope that it will be useful, but WITHOUT
 * ANY WARRANTY; without even the implied warranty of MERCHANTABILITY or
 * FITNESS FOR A PARTICULAR PURPOSE. See the GNU General Public License for
 * more details.
 *
 * You should have received a copy of the GNU General Public License along with
 * this program; if not, write to the Free Software Foundation, Inc., 59 Temple
 * Place, Suite 330, Boston, MA 02111-1307 USA
 */

/dts-v1/; /plugin/;
/ {
        fragment@0 {
        target-path="/soc/fpga-region0";
        #address-cells=<1>;
        #size-cells=<1>;
        __overlay__ {
                firmware-name="altera_msgdma_socfpga.rbf";
                #address-cells=<1>;
                #size-cells=<1>;
                
                msgdma_streaming_write: msgdma@c0000000 {
                            compatible = "altr,altera-msgdma-st-1.0";
                            reg = <0xc0000000 0x00000020>,
                                <0xc0000020 0x00000010>;
                            reg-names = "csr", "descriptor_slave";
                            string-property = "msgdma_write";
                            interrupts = <0 40 4>;
                            clocks = <&clk_0>;
                        };

                msgdma_streaming_read: msgdma@c0001000 {
                            compatible = "altr,altera-msgdma-st-1.0";
                            reg = <0xc0001000 0x00000020>,
                                <0xc0001020 0x00000010>;
                            reg-names = "csr", "descriptor_slave";
                            string-property = "msgdma_read";
                            interrupts = <0 41 4>;
                            clocks = <&clk_0>;
                        };
                
                };
        };
};
